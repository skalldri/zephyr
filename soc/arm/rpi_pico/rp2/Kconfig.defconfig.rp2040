## soc/arm/rpi_pico/rp2/Kconfig.defconfig.rp2040
```kconfig
# # Raspberry Pi RP2040 MCU

# Copyright (c) 2021 Nordic Semiconductor ASA
# SPDX-License-Identifier: Apache-2.0

config SOC
	default "rp2040"
	depends on SOC_RP2040

config BUILD_OUTPUT_UF2_USE_FLASH_BASE
	default y if RP2_REQUIRES_SECOND_STAGE_BOOT

config BUILD_OUTPUT_UF2_USE_FLASH_OFFSET
	default y if !RP2_REQUIRES_SECOND_STAGE_BOOT

if SMP

# Used to select the required PICOSDK_USE_MUTLICORE symbol
config RP2040_SMP
	bool
	default y
	select PICOSDK_USE_MULTICORE

# RP2040 has two CPUs that can be used in SMP mode
config MP_NUM_CPUS
	default 2

endif
```
